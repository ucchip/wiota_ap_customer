## Kconfig
```kconfig
mainmenu "RT-Thread Configuration"

config WIOTA_DEMO
    string
    option env="WIOTA_DEMO_ROOT"
    default "app"

config WIOTA_APP
    string
    option env="WIOTA_APP_ROOT"
    default "applications"

config WIOTA_PS
    string
    option env="WIOTA_PS_ROOT"
    default "PS"

config RTT_DIR
    string
    option env="RTT_ROOT"
    default "rt-thread"

config PKGS_DIR_WIOTA
    string
    option env="PKGS_ROOT_WIOTA"
    default "packages"

source "$RTT_DIR/Kconfig"
source "$WIOTA_DEMO/Kconfig"
source "$WIOTA_APP/Kconfig"
source "$WIOTA_PS/Kconfig"
source "$PKGS_DIR_WIOTA/Kconfig"
```

## PS/Kconfig
```kconfig
menu "wiota PS"

config _FPGA_
    bool "default open(_FPGA_)"
    default y

config _RT_THREAD_
    bool "RT_Thread default open(_RT_THREAD_)"
    default y

config _FPGA_TRACE_TEST_
    bool "default open(_FPGA_TRACE_TEST_)"
    default y

config UC8088_FACTORY_TEST
    bool "factory mode, recv and send test, default open(UC8088_FACTORY_TEST)"
    default y

config SLAVER_UC8x88_SUPPORT
    bool "use slaver uc8x88 spi w/r api, default open(SLAVER_UC8x88_SUPPORT)"
    default y

config WIOTA_AP_STATE_INFO
    bool "query ap state info, default close(WIOTA_AP_STATE_INFO)"
    default n

config WIOTA_IOTE_INFO
    bool "query iote info, default close(WIOTA_IOTE_INFO)"
    default n

config PTPVT2_SUPPORT
    bool "1588 protocol support, default close(PTPVT2_SUPPORT)"
    default n

config ZCRD_CUSTOMER
    bool "default close(ZCRD_CUSTOMER)"
    default n

endmenu
```

## app/Kconfig
```kconfig
menu "wiota APP DEMO"

config WIOTA_APP_DEMO
    bool "app demo macro(WIOTA_APP_DEMO)"
    default n

endmenu
```

## applications/Kconfig
```kconfig
menu "wiota APP"

config WIOTA_API_TEST
    bool "uc wiota api test, default close(WIOTA_API_TEST)"
    default y

config M8_GATEWAY_MODE_SUPPORT
    bool "release version must close, m8 gateway used(M8_GATEWAY_MODE_SUPPORT)"
    default y

if RT_USING_WDT
    config _WATCHDOG_APP_
        bool "open wdt, default close(_WATCHDOG_APP_)"
        default n
endif

endmenu
```

## packages/Kconfig
```kconfig
menu "IoT - internet of things"

source "$PKGS_DIR_WIOTA/at_device/Kconfig"
source "$PKGS_DIR_WIOTA/uc_wolfMQTT/Kconfig"
source "$PKGS_DIR_WIOTA/webclient/Kconfig"

endmenu

menu "Security packages (AES/MD5)"

source "$PKGS_DIR_WIOTA/tinycrypt/Kconfig"

endmenu
```

## packages/at_device/Kconfig
```kconfig
# AT device configuretion
menuconfig PKG_USING_UCC_AT_DEVICE
    bool "AT DEVICE: Ucchip AT component porting or samples for different device"
    default n
    select RT_USING_AT
    select AT_USING_CLIENT
    select AT_USING_SOCKET
        
if PKG_USING_UCC_AT_DEVICE

    config PKG_AT_DEVICE_PATH
        string
        default "/packages/at_device"

        choice
            prompt "Version"
            help
                Select the UCC_AT_DEVICE version

            config PKG_USING_UCC_AT_DEVICE_LATEST_VERSION
                bool "latest"

            config PKG_AT_DEVICE_VER
                string
                default "latest"
                
        endchoice
        
        source "$PKGS_DIR_WIOTA/at_device/class/ml305/Kconfig"
        source "$PKGS_DIR_WIOTA/at_device/class/ml302/Kconfig"
		
endif
```

## packages/at_device/class/ml305/Kconfig
```kconfig
# Ml305 AT device configuration

menuconfig AT_DEVICE_USING_ML305
    bool "China Moblie Ml305"
    default n
    
if AT_DEVICE_USING_ML305

    config AT_DEVICE_ML305_INIT_ASYN
        bool "Enable initialize by thread"
        default n

    config AT_DEVICE_ML305_SAMPLE
        bool "Enable sample"
        default y

    if AT_DEVICE_ML305_SAMPLE

       config ML305_SAMPLE_POWER_EN_PIN
            int "Power Enable pin"
            default -1

       config ML305_SAMPLE_POWER_PIN
            int "Power pin"
            default -1

        config ML305_SAMPLE_STATUS_PIN
            int "Power status pin"
            default -1

        config ML305_SAMPLE_CLIENT_NAME
            string "AT client device name"
            default "uart0"

        config ML305_SAMPLE_RECV_BUFF_LEN
            int "The maximum length of receive line buffer"
            default 512

    endif

endif
```

## packages/tinycrypt/Kconfig
```kconfig
# WebClient configuretion
menuconfig PKG_USING_TINYCRYPT
    bool "TinyCrypt: A tiny and configurable crypt library"
    default n
    config TINY_CRYPT_MD5
    	bool "MD5"
		depends on PKG_USING_TINYCRYPT
    	default y
    config TINY_CRYPT_BASE64
    	bool "Base64"
		depends on PKG_USING_TINYCRYPT
    	default n
    config TINY_CRYPT_AES
    	bool "AES"
		depends on PKG_USING_TINYCRYPT
    	default n
    config TINY_CRYPT_SHA1
    	bool "SHA1"
		depends on PKG_USING_TINYCRYPT
    	default n
    config TINY_CRYPT_SHA256
    	bool "SHA256"
		depends on PKG_USING_TINYCRYPT
    	default n
```

## packages/uc_wolfMQTT/Kconfig
```kconfig
# uc_wolfMQTT configuretion
menuconfig PKG_USING_UC_WOLFMQTT
    bool "uc_wolfMQTT: MQTT client "
    default n
    select RT_USING_SAL
    select SAL_USING_POSIX
        
if PKG_USING_UC_WOLFMQTT

    config PKG_UC_WOLFMQTT_PATH
        string
        default "/uc_wolfMQTT"
		
    choice
        prompt "version"
        help
            Select the uc_wolfmqtt version

        config PKG_UC_WOLFMQTT_LATEST_VERSION
            bool "latest"

    endchoice

    config PKG_UC_WOLFMQTT_VER
       string
       default "latest" if PKG_UC_WOLFMQTT_LATEST_VERSION

    config ENABLE_MQTT_TLS
        bool "Enable TLS Support"
        default n
        
    config WOLFMQTT_SN
        bool "Enable MQTT-SN(Sensor Network) Support"
        default n
        
    config WOLFMQTT_V5
        bool "Enable MQTT v5.0 support"
        default n        

    if WOLFMQTT_V5
        config WOLFMQTT_PROPERTY_CB
            bool "Enable property callback support"
            default n
    endif
        
    config WOLFMQTT_NONBLOCK
        bool "Enable Non-blocking support"
        default n
        
    config WOLFMQTT_NO_TIMEOUT
        bool "Disable socket timeout code"
        default n
        
    config WOLFMQTT_DISCONNECT_CB
        bool "Enable Disconnect callback support"
        default n
        
    config WOLFMQTT_MULTITHREAD
        bool "Enable Multi-threading"
        default n
        select RT_USING_LIBC
        select RT_USING_PTHREADS

    config DEBUG_WOLFMQTT
        bool "Enable Debugging"
        default n

    if DEBUG_WOLFMQTT
        config WOLFMQTT_DEBUG_CLIENT
            bool "Enable Debugging client"
            default n

        config WOLFMQTT_DEBUG_SOCKET
            bool "Enable Debugging socket"
            default n

        config WOLFMQTT_DEBUG_THREAD
            bool "Enable Debugging thread"
            default n
    endif

    config WOLFMQTT_NO_ERROR_STRINGS
        bool "Disable error strings"
        default n	
endif
```

## packages/webclient/Kconfig
```kconfig
# WebClient configuretion
menuconfig PKG_USING_WEBCLIENT
    bool "WebClient: A HTTP/HTTPS Client for RT-Thread"
    default n
    config WEBCLIENT_USING_FILE_DOWMLOAD
    	bool "Using file download(WEBCLIENT_USING_FILE_DOWMLOAD)"
		depends on PKG_USING_WEBCLIENT
    	default y
```
